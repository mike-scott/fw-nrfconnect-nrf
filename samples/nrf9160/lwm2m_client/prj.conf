## Kconfig
```
#
# Copyright (c) 2018 Nordic Semiconductor ASA
#
# SPDX-License-Identifier: LicenseRef-BSD-5-Clause-Nordic
#

menu "Application sample"

rsource "src/ui/Kconfig"

config APP_LWM2M_SERVER
	string "LwM2M server name or IP address"
	default "198.199.108.159"
	help
	  Choose the LwM2M server you wish to connect to.

config APP_HOLD_TIME_RSRP
	int "Minimum time [s] between RSRP notification messages"
	default 60
	help
	  The minimum time in seconds that notifications can be sent to
	  observers of the Connectivity Monitoring data.

config APP_HOLD_TIME_GSP
	int "Minimum time [s] between RSRP notification messages"
	default 60
	help
	  The minimum time in seconds that notifications can be sent to
	  observers of the Location data.

choice
	prompt "GPS device"
	default GPS_USE_SIM
	help
		Select from which device GPS data will be fetched.

config GPS_USE_SIM
	bool "Use GPS simulator"
	select GPS_SIM
	select GPS_SIM_TRIGGER
	help
		Use simulated GPS data.

config GPS_USE_EXTERNAL
	bool "User provided GPS device"
	help
		Provide a GPS device that location data will be fetched from and
		sent to nRF Cloud

endchoice

if GPS_USE_SIM

config GPS_DEV_NAME
	string
	default GPS_SIM_DEV_NAME

config GPS_TRIGGER
	bool
	default GPS_SIM_TRIGGER

endif

if GPS_USE_EXTERNAL
config GPS_DEV_NAME
	string "GPS device name"
	help
		GPS device from which location data will be fetched and sent
		to nRF Cloud.

endif

choice
	prompt "Accelerometer device"
	default ACCEL_USE_SIM
	help
		Select which device will provide accelerometer data.

config ACCEL_USE_SIM
	bool "Use simulated accelerometer data"
	select SENSOR
	select SENSOR_SIM
	select SENSOR_SIM_TRIGGER
	select SENSOR_SIM_STATIC_VALUES
	help
		Use sensor simulator to generate accelerometer data for
		flip detection data sent to nRF Cloud.

config ACCEL_USE_EXTERNAL
	bool "User provided accelerometer device"
	help
		The user will provide an accelerometer device that will
		be used for flip detection.

endchoice

if ACCEL_USE_SIM
config ACCEL_DEV_NAME
	string
	default SENSOR_SIM_DEV_NAME

config ACCEL_TRIGGER
	bool
	default SENSOR_SIM_TRIGGER

config FLIP_INPUT
	int "Button or switch number to simulate flip"
	range 1 4 if BOARD_NRF9160_PCA10090NS
	default 3 if BOARD_NRF9160_PCA10090NS
	help
		Button or switch number to use for simulating
		a board flip event.
		1 - Button 1
		2 - Button 2
		3 - Switch 1
		4 - Switch 2
endif

config FLIP_POLL
	bool "Use polling to detect flip"
	help
		Poll the defined accelerometer device at interval determined by
		FLIP_POLL_INTERVAL. Data will be sent to nRF Cloud if a flip
		has happened and the orientation thus has changed.

if FLIP_POLL
config FLIP_POLL_INTERVAL
	int "Flip detection poll interval"
	default 1000
	help
		Flip polling interval in milliseconds.
endif

if ACCEL_USE_EXTERNAL

config ACCEL_DEV_NAME
	string "Accelerometer device name"
	help
		Device from which accelerometer data will be fetched and used
		for orientation detection and sent to nRF Cloud.

endif

config ACCEL_INVERTED
	bool "Accelerometer inverted"
	help
		Enable if the accelerometer is mounted with the top side facing
		down when the board itself is in normal position.

config ACCEL_CALIBRATE
	bool "Calibrate accelerometer"
	help
		Calibrate the accelerometer on a flat surface to filter away
		static measurement offset that could affect orientation
		detection.

if ACCEL_CALIBRATE
config ACCEL_CALIBRATION_ITERATIONS
	int "Number of readings for calibration"
	help
		Number of measurement readings to average over to find the
		static offset in the readings when calibrating the
		accelerometer.

config CALIBRATION_INPUT
	int "Button to trigger accelerometer calibration"
	range 1 2 if BOARD_NRF9160_PCA10090NS
	default 1 if BOARD_NRF9160_PCA10090NS
	help
		Button number to use to trigger accelerometer calibration:
		1 - Button 1
		2 - Button 2
endif

if !ACCEL_CALIBRATE
config ACCEL_CALIBRATION_ITERATIONS
	int
	default 0
endif

config ACCEL_ITERATIONS
	int "Number of readings per measurement"
	default 1
	help
		Number of measurement readings to average over for each time
		the orientation detector determines the orientation of the
		board. Used for simple filtering of noisy measurements.

module = APP
module-dep = LOG
module-str = Log level for sample
source "subsys/logging/Kconfig.template.log_config"

endmenu

menu "Zephyr Kernel"
source "$ZEPHYR_BASE/Kconfig.zephyr"
endmenu
```

## sample.yaml
```
sample:
  name: nrf LwM2M Sample
tests:
  test_build:
    build_only: true
    build_on_all: true
    platform_whitelist: nrf9160_pca10090ns
    tags: ci_build
```

## prj.conf
```kconfig
# General config
CONFIG_NEWLIB_LIBC=y
CONFIG_TEST_RANDOM_GENERATOR=y
CONFIG_ASSERT=y
CONFIG_REBOOT=y

# Network
CONFIG_NETWORKING=y
CONFIG_NET_SOCKETS=y
CONFIG_NET_SOCKETS_OFFLOAD=y

# LwM2M
CONFIG_LWM2M=y
CONFIG_LWM2M_RW_JSON_SUPPORT=n
CONFIG_LWM2M_SERVER_DEFAULT_PMIN=1
CONFIG_LWM2M_SERVER_DEFAULT_PMAX=300
CONFIG_LWM2M_CONN_MON_OBJ_SUPPORT=y
CONFIG_LWM2M_CONN_MON_BEARER_MAX=2
CONFIG_LWM2M_FIRMWARE_UPDATE_OBJ_SUPPORT=y
CONFIG_LWM2M_LOCATION_OBJ_SUPPORT=y
CONFIG_LWM2M_IPSO_SUPPORT=y
CONFIG_LWM2M_IPSO_TEMP_SENSOR=y
CONFIG_LWM2M_IPSO_LIGHT_CONTROL=y
CONFIG_LWM2M_IPSO_BUZZER=y
CONFIG_LWM2M_IPSO_ONOFF_SWITCH=y
CONFIG_LWM2M_IPSO_ONOFF_SWITCH_INSTANCE_COUNT=2
CONFIG_LWM2M_IPSO_PUSH_BUTTON=y
CONFIG_LWM2M_IPSO_PUSH_BUTTON_INSTANCE_COUNT=2
CONFIG_LWM2M_IPSO_ACCELEROMETER=y

# DTLS settings
CONFIG_LWM2M_DTLS_SUPPORT=y
CONFIG_LWM2M_PEER_PORT=5684

# MBEDTLS settings
CONFIG_MBEDTLS_CIPHER_CCM_ENABLED=y
# Disable RSA, we don't parse certs: saves flash/memory
CONFIG_MBEDTLS_KEY_EXCHANGE_RSA_ENABLED=n
# Enable PSK instead
CONFIG_MBEDTLS_KEY_EXCHANGE_PSK_ENABLED=y
CONFIG_NET_SOCKETS_TLS_MAX_CONTEXTS=4

# Default app to debug logging
CONFIG_LOG=y
CONFIG_APP_LOG_LEVEL_DBG=y

# Expand logging memory to avoid log_strdup() errors
CONFIG_LOG_STRDUP_MAX_STRING=64
CONFIG_LOG_STRDUP_BUF_COUNT=32

# Support HEX style PSK values (double the size + NULL char)
CONFIG_LWM2M_SECURITY_KEY_SIZE=33

# extend CoAP retry timing to 10 seconds for LTE/LTE-M
CONFIG_COAP_INIT_ACK_TIMEOUT_MS=10000

# UI settings
CONFIG_UI_BUTTON=y
CONFIG_UI_BUZZER=y

# FOTA
CONFIG_BOOTLOADER_MCUBOOT=y
CONFIG_IMG_MANAGER=y
CONFIG_MCUBOOT_IMG_MANAGER=y
CONFIG_IMG_ERASE_PROGRESSIVELY=y
CONFIG_FLASH=y
CONFIG_MPU_ALLOW_FLASH_WRITE=y

# Enable temp sensor
CONFIG_SENSOR=y
# TODO: No DIE temp sensor on nRF9150, select a temp sensor?
# CONFIG_TEMP_NRF5=y

# Enable settings storage
CONFIG_SETTINGS=y
CONFIG_FCB=y
CONFIG_SETTINGS_FCB=y

# LTE link control
CONFIG_LTE_LINK_CONTROL=y
CONFIG_LTE_AUTO_INIT_AND_CONNECT=n

# BSD library
CONFIG_BSD_LIBRARY=y

# Modem info
CONFIG_MODEM_INFO=y

# Library for buttons and LEDs
CONFIG_DK_LIBRARY=y
CONFIG_DK_LIBRARY_INVERT_LEDS=n

# Enable shell
CONFIG_NET_SHELL=y

# Heap and stacks
CONFIG_HEAP_MEM_POOL_SIZE=16384
CONFIG_MAIN_STACK_SIZE=8192
CONFIG_GPS_SIM_THREAD_STACK_SIZE=1024
CONFIG_SYSTEM_WORKQUEUE_STACK_SIZE=2048
#CONFIG_HW_STACK_PROTECTION=y

# Disable native network stack to save some memory
CONFIG_NET_IPV4=n
CONFIG_NET_IPV6=n
CONFIG_NET_UDP=n
CONFIG_NET_TCP=n
CONFIG_NET_RX_STACK_SIZE=256
CONFIG_NET_TX_STACK_SIZE=256

# Set LwM2M Server IP address
CONFIG_APP_LWM2M_SERVER=""
```

## src/main.c
```c
/*
 * Copyright (c) 2019 Foundries.io
 *
 * SPDX-License-Identifier: LicenseRef-BSD-5-Clause-Nordic
 */

#include <zephyr.h>
#include <ctype.h>
#include <gpio.h>
#include <stdio.h>
#include <net/lwm2m.h>
#include <net/bsdlib.h>
#include <settings/settings.h>

#include <logging/log.h>
LOG_MODULE_REGISTER(app_lwm2m_client, CONFIG_APP_LOG_LEVEL);

#include <at_cmd.h>
#include <lte_lc.h>

#if defined(CONFIG_LWM2M_DTLS_SUPPORT)
#include "nrf_inbuilt_key.h"
#endif

#include "ui.h"
#include "lwm2m_client.h"
#include "settings.h"

#if !defined(CONFIG_LTE_LINK_CONTROL)
#error "Missing CONFIG_LTE_LINK_CONTROL"
#endif

BUILD_ASSERT_MSG(sizeof(CONFIG_APP_LWM2M_SERVER) > 1,
		"CONFIG_APP_LWM2M_SERVER must be set in prj.conf");

#define APP_BANNER "Run LWM2M client"

#define IMEI_LEN		15
#define ENDPOINT_NAME_LEN	(IMEI_LEN + 8)

static u8_t endpoint_name[ENDPOINT_NAME_LEN+1];
static u8_t imei_buf[IMEI_LEN + 5]; /* account for /n/r */
static struct lwm2m_ctx client;

#if defined(CONFIG_LWM2M_DTLS_SUPPORT)
#include "config.h"
#endif /* CONFIG_LWM2M_DTLS_SUPPORT */

static struct k_sem quit_lock;

/**@brief User interface event handler. */
static void ui_evt_handler(struct ui_evt *evt)
{
	if (!evt) {
		return;
	}

	LOG_DBG("Event: %d", evt->button);

#if defined(CONFIG_UI_BUTTON)
	if (handle_button_events(evt) == 0) {
		return;
	}
#endif
#if defined(CONFIG_LWM2M_IPSO_ACCELEROMETER) && CONFIG_FLIP_INPUT > 0
	if (handle_accel_events(evt) == 0) {
		return;
	}
#endif
}

static int remove_whitespace(char *buf)
{
	size_t i, j = 0, len;

	len = strlen(buf);
	for (i = 0; i < len; i++) {
		if (buf[i] >= 32 && buf[i] <= 126) {
			if (j != i) {
				buf[j] = buf[i];
			}

			j++;
		}
	}

	if (j < len) {
		buf[j] = '\0';
	}

	return 0;
}

static int query_modem(const char *cmd, char *buf, size_t buf_len)
{
	int ret;
	enum at_cmd_state at_state;

	ret = at_cmd_write(cmd, buf, buf_len, &at_state);
	if (ret) {
		LOG_ERR("at_cmd_write [%s] error:%d, at_state: %d",
			cmd, ret, at_state);
		strncpy(buf, "error", buf_len);
		return ret;
	}

	remove_whitespace(buf);
	return 0;
}

static int lwm2m_setup(void)
{
	/* use IMEI as serial number */
	lwm2m_init_device(imei_buf);
	lwm2m_init_security(&client, endpoint_name);
#if defined(CONFIG_LWM2M_LOCATION_OBJ_SUPPORT)
	lwm2m_init_location();
#endif
#if defined(CONFIG_LWM2M_FIRMWARE_UPDATE_OBJ_SUPPORT)
	lwm2m_init_firmware();
#endif
#if defined(CONFIG_LWM2M_CONN_MON_OBJ_SUPPORT)
	lwm2m_init_connmon();
#endif
#if defined(CONFIG_LWM2M_IPSO_LIGHT_CONTROL)
	lwm2m_init_light_control();
#endif
#if defined(CONFIG_LWM2M_IPSO_TEMP_SENSOR)
	lwm2m_init_temp();
#endif
#if defined(CONFIG_UI_BUZZER)
	lwm2m_init_buzzer();
#endif
#if defined(CONFIG_UI_BUTTON)
	lwm2m_init_button();
#endif
#if defined(CONFIG_LWM2M_IPSO_ACCELEROMETER)
	lwm2m_init_accel();
#endif
	return 0;
}

static void rd_client_event(struct lwm2m_ctx *client,
			    enum lwm2m_rd_client_event client_event)
{
	switch (client_event) {

	case LWM2M_RD_CLIENT_EVENT_NONE:
		/* do nothing */
		break;

	case LWM2M_RD_CLIENT_EVENT_BOOTSTRAP_REG_FAILURE:
		LOG_DBG("Bootstrap registration failure!");
		break;

	case LWM2M_RD_CLIENT_EVENT_BOOTSTRAP_REG_COMPLETE:
		LOG_DBG("Bootstrap registration complete");
		break;

	case LWM2M_RD_CLIENT_EVENT_BOOTSTRAP_TRANSFER_COMPLETE:
		LOG_DBG("Bootstrap transfer complete");
		break;

	case LWM2M_RD_CLIENT_EVENT_REGISTRATION_FAILURE:
		LOG_DBG("Registration failure!");
		break;

	case LWM2M_RD_CLIENT_EVENT_REGISTRATION_COMPLETE:
		LOG_DBG("Registration complete");
		break;

	case LWM2M_RD_CLIENT_EVENT_REG_UPDATE_FAILURE:
		LOG_DBG("Registration update failure!");
		break;

	case LWM2M_RD_CLIENT_EVENT_REG_UPDATE_COMPLETE:
		LOG_DBG("Registration update complete");
		break;

	case LWM2M_RD_CLIENT_EVENT_DEREGISTER_FAILURE:
		LOG_DBG("Deregister failure!");
		break;

	case LWM2M_RD_CLIENT_EVENT_DISCONNECT:
		LOG_DBG("Disconnected");
		break;

	}
}

void main(void)
{
	int ret;

	LOG_INF(APP_BANNER);

	k_sem_init(&quit_lock, 0, UINT_MAX);

	ui_init(ui_evt_handler);

	ret = fota_settings_init();
	if (ret < 0) {
		LOG_ERR("Unable to init settings (%d)", ret);
		return;
	}

	/* Load *all* persistent settings */
	settings_load();

	LOG_INF("Initializing modem.");
	ret = lte_lc_init();
	if (ret < 0) {
		LOG_ERR("Unable to init modem (%d)", ret);
		return;
	}

	/* query IMEI */
	query_modem("AT+CGSN", imei_buf, sizeof(imei_buf));
	/* use IMEI as unique endpoint name */
	snprintf(endpoint_name, sizeof(endpoint_name), "nrf-%s", imei_buf);
	LOG_INF("endpoint: %s", log_strdup(endpoint_name));

	/* Setup LwM2M */
	(void)memset(&client, 0x0, sizeof(client));
	ret = lwm2m_setup();
	if (ret < 0) {
		LOG_ERR("Cannot setup LWM2M fields (%d)", ret);
		return;
	}

	ret = lwm2m_init_image();
	if (ret < 0) {
		LOG_ERR("Failed to setup image properties (%d)", ret);
		return;
	}

#if defined(CONFIG_LWM2M_DTLS_SUPPORT)
	ret = -nrf_inbuilt_key_write(client.tls_tag,
				     NRF_KEY_MGMT_CRED_TYPE_PSK,
				     client_psk, strlen(client_psk));
	if (ret < 0) {
		LOG_ERR("Error setting cred tag %d type %d: Error %d",
			client.tls_tag, NRF_KEY_MGMT_CRED_TYPE_PSK,
			ret);
	}

	ret = -nrf_inbuilt_key_write(client.tls_tag,
				     NRF_KEY_MGMT_CRED_TYPE_IDENTITY,
				     endpoint_name, strlen(endpoint_name));
	if (ret < 0) {
		LOG_ERR("Error setting cred tag %d type %d: Error %d",
			client.tls_tag, NRF_KEY_MGMT_CRED_TYPE_IDENTITY,
			ret);
	}
#endif

	/* setup modem */
	LOG_INF("Connecting to LTE network.");
	LOG_INF("This may take several minutes.");
	ui_led_set_pattern(UI_LTE_CONNECTING);

	ret = lte_lc_connect();
	__ASSERT(ret == 0, "LTE link could not be established.");

	LOG_INF("Connected to LTE network");
	ui_led_set_pattern(UI_LTE_CONNECTED);

#if defined(CONFIG_LWM2M_CONN_MON_OBJ_SUPPORT)
	ret = lwm2m_start_connmon();
	if (ret < 0) {
		LOG_ERR("Error registering rsrp handler (%d)", ret);
	}
#endif

	lwm2m_rd_client_start(&client, endpoint_name, rd_client_event);
	k_sem_take(&quit_lock, K_FOREVER);
}
```

## src/settings.c
```c
/*
 * Copyright (c) 2019 Foundries.io
 *
 * SPDX-License-Identifier: Apache-2.0
 */

#define LOG_MODULE_NAME fota_storage
#define LOG_LEVEL CONFIG_FOTA_LOG_LEVEL

#include <logging/log.h>
LOG_MODULE_REGISTER(LOG_MODULE_NAME);

#include <zephyr.h>
#include <settings/settings.h>

#include "settings.h"

static struct update_counter uc;

int fota_update_counter_read(struct update_counter *update_counter)
{
	memcpy(update_counter, &uc, sizeof(uc));
	return 0;
}

int fota_update_counter_update(update_counter_t type, u32_t new_value)
{
	if (type == COUNTER_UPDATE) {
		uc.update = new_value;
	} else {
		uc.current = new_value;
	}

	return settings_save_one("fota/counter", &uc, sizeof(uc));
}

static int set(const char *key, size_t len_rd, settings_read_cb read_cb,
	       void *cb_arg)
{
	int len;
	int key_len;
	const char *next;

	if (!key) {
		return -ENOENT;
	}

	key_len = settings_name_next(key, &next);

	if (!strncmp(key, "counter", key_len)) {
		len = read_cb(cb_arg, &uc, sizeof(uc));
		if (len < sizeof(uc)) {
			LOG_ERR("Unable to read update counter.  Resetting.");
			memset(&uc, 0, sizeof(uc));
		}

		return 0;
	}

	return -ENOENT;
}

static struct settings_handler fota_settings = {
	.name = "fota",
	.h_set = set,
};

int fota_settings_init(void)
{
	int err;

	err = settings_subsys_init();
	if (err) {
		LOG_ERR("settings_subsys_init failed (err %d)", err);
		return err;
	}

	err = settings_register(&fota_settings);
	if (err) {
		LOG_ERR("settings_register failed (err %d)", err);
		return err;
	}

	return 0;
}
```
